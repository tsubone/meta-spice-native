## conf/layer.conf
```bitbake
# We have a conf and classes directory, add to BBPATH
BBPATH .= ":${LAYERDIR}"

# We have recipes-* directories, add to BBFILES
BBFILES += "${LAYERDIR}/recipes-*/*/*.bb \
	${LAYERDIR}/recipes-*/*/*.bbappend"

BBFILE_COLLECTIONS += "meta-spice-native"
BBFILE_PATTERN_meta-spice-native = "^${LAYERDIR}/"
BBFILE_PRIORITY_meta-spice-native = "6"
```
